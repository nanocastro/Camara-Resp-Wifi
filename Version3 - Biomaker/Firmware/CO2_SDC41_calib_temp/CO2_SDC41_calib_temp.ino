
#include <Arduino.h>
#include <Wire.h>

//// Temperature sensor 
//#include <OneWire.h>
//#include <DallasTemperature.h>
//// Data wire is plugged into port 2 on the Arduino
//#define ONE_WIRE_BUS 2
// define DS18B20 data pin connection
#define DS18B20_PIN   A0

// OLED stuffs **********************
#include <Adafruit_GFX.h>
#include <Adafruit_SSD1306.h>
#define OLED_RESET -1
#define SCREEN_ADDRESS 0x3C
#define SCREEN_WIDTH 128 // OLED display width, in pixels
#define SCREEN_HEIGHT 64 // OLED display height, in pixels
uint32_t displayLimit = 1400;
uint32_t displayFactor = displayLimit / 48;
uint32_t meas_counter = 0;
int32_t thresholdPPM = 450;

Adafruit_SSD1306 display(SCREEN_WIDTH, SCREEN_HEIGHT, &Wire, OLED_RESET);

// """"""""""""""""""""""""""""""""""

// SCD4x **********************
const int16_t SCD_ADDRESS = 0x62;

unsigned long getDataTimer = 0;

const int cal_pin = 6;  // calibration button
unsigned long timeElapse = 0;//used to wait the sensor to stabilize before calibration

float co2, temperature, humidity;
  uint16_t calibration;
  uint8_t data[12], counter, repetition;
  uint8_t ret;
// """"""""""""""""""""""""""""""""""

// DS18B20 **********************
// Setup a oneWire instance to communicate with any OneWire devices (not just Maxim/Dallas temperature ICs)
//OneWire oneWire(ONE_WIRE_BUS);
//// Pass our oneWire reference to Dallas Temperature. 
//DallasTemperature sensors(&oneWire);




void setup() {
  
  Serial.begin(9600);
  // wait for serial connection from PC
  // comment the following line if you'd like the output
  // without waiting for the interface being ready
  while(!Serial);
  pinMode(cal_pin, INPUT_PULLUP); // entrada pulsado para calibrar, seteada como pulluppara poder conectar pulsador sin poenr resistencia adicional

  //Init OneWire
//   sensors.begin();


  // init I2C
  Wire.begin();

    delay(500);
    initDisplay();
    delay(100);

    showLogo_humus_text();
    delay(500);
    showLogo_oursci();
    delay(500);
    showLogo_hackteria();
    delay(500);
    showLogo_regosh();
    delay(5000);
    showLogo_biomaker();
    delay(5000);

  OLEDdrawBackground();

  // wait until sensors are ready, > 1000 ms according to datasheet
  delay(1000);
  
  // start scd measurement in periodic mode, will update every 5 s
  Wire.beginTransmission(SCD_ADDRESS);
  Wire.write(0x21);
  Wire.write(0xb1);
  Wire.endTransmission();
  // wait for first measurement to be finished
  delay(2000);
}
void loop() {
  if (digitalRead(cal_pin) == LOW) {  // if cal button is pressed enters calibration routine
  Serial.write("calibrando");
  calibrar();
  }  

  if (millis() - getDataTimer >= 5000){
    
  float co2, temperature, humidity;
  uint8_t data[12], counter;

  // send read data command
  Wire.beginTransmission(SCD_ADDRESS);
  Wire.write(0xec);
  Wire.write(0x05);
  Wire.endTransmission();
  
  // read measurement data: 2 bytes co2, 1 byte CRC,
  // 2 bytes T, 1 byte CRC, 2 bytes RH, 1 byte CRC,
  // 2 bytes sensor status, 1 byte CRC
  // stop reading after 12 bytes (not used)
  // other data like  ASC not included
  Wire.requestFrom(SCD_ADDRESS, 12);
  counter = 0;
  while (Wire.available()) {
    data[counter++] = Wire.read();
  }
  
  // floating point conversion according to datasheet
  co2 = (float)((uint16_t)data[0] << 8 | data[1]);
  // convert T in degC
  temperature = -45 + 175 * (float)((uint16_t)data[3] << 8 | data[4]) / 65536;
  // convert RH in %
  humidity = 100 * (float)((uint16_t)data[6] << 8 | data[7]) / 65536;

  Serial.print(getDataTimer);
  Serial.print(" ");
  Serial.print (co2);
  Serial.println();

  OLEDshowCO2(co2, temperature, humidity);

  // call sensors.requestTemperatures() to issue a global temperature 
  // request to all devices on the bus
//  Serial.print("Requesting temperatures...");
//  sensors.requestTemperatures(); // Send the command to get temperatures
//  Serial.println("DONE");
//  // After we got the temperatures, we can print them here.
//  // We use the function ByIndex, and as an example get the temperature from the first sensor only.
//  float tempC = sensors.getTempCByIndex(0);
//
//  // Check if reading was successful
//  if(tempC != DEVICE_DISCONNECTED_C) 
//  {
//    Serial.print("Temperature for the device 1 (index 0) is: ");
//    Serial.println(tempC);
//  } 
//  else
//  {
//    Serial.println("Error: Could not read temperature data");
//  }

  getDataTimer = millis();
  meas_counter++;
   }
  
}



//Calibrar 
void calibrar(){

Serial.println("# CO2 values before recalibration");

  // measure 5 times 
  for(repetition = 0; repetition < 5; repetition++) {
    // read measurement data: 2 bytes co2, 1 byte CRC,
    // 2 bytes T, 1 byte CRC, 2 bytes RH, 1 byte CRC,
    // 2 bytes sensor status, 1 byte CRC
    // stop reading after 12 bytes (not used)
    // other data like  ASC not included
    Wire.requestFrom(SCD_ADDRESS, 12);
    counter = 0;
    while (Wire.available()) {
      data[counter++] = Wire.read();
    }
    
    // floating point conversion according to datasheet
    co2 = (float)((uint16_t)data[0] << 8 | data[1]);
    // convert T in degC
    temperature = -45 + 175 * (float)((uint16_t)data[3] << 8 | data[4]) / 65536;
    // convert RH in %
    humidity = 100 * (float)((uint16_t)data[6] << 8 | data[7]) / 65536;
  
    Serial.print("# ");
    Serial.print(co2);
    Serial.print("\t");
    Serial.print(temperature);
    Serial.print("\t");
    Serial.print(humidity);
    Serial.println();

    delay(2000);
  }
  
  // wait for another 5 minutes to equilibrate sensor to ambient
  Serial.println("# Waiting 20 minutes for equilibration");
  //delay(5 * 60 * 1000);
  timeElapse = getDataTimer+12e5;                    //  20 minutes in milliseconds
    while(millis() < timeElapse) {};

  // stop scd measurement
  Wire.beginTransmission(SCD_ADDRESS);
  Wire.write(0x3f);
  Wire.write(0x86);
  ret = Wire.endTransmission();
  Serial.println(ret);

  // wait for sensor
  delay(20);

  // assuming an external reference shows 400 ppm
  calibration = 400;
  
  // prepare buffer with data for calibration
  // calculate CRC for each 2 bytes of data
  data[0] = (calibration & 0xff00) >> 8;
  data[1] = calibration & 0x00ff;
  data[2] = CalcCrc(data);
  
  // send command for perform_forced_recalibration
  Wire.beginTransmission(SCD_ADDRESS);
  Wire.write(0x36);
  Wire.write(0x2F);
  // append data for calibration
  // 2 bytes calibraion, CRC
  Wire.write(data[0]);
  Wire.write(data[1]);
  Wire.write(data[2]);
  ret = Wire.endTransmission();
  Serial.println(ret);

  delay(400);
  
  // read data: 2 bytes correction, 1 byte CRC
  Wire.requestFrom(SCD_ADDRESS, 3);
  counter = 0;
  while (Wire.available()) {
    data[counter++] = Wire.read();
  }

  if(CalcCrc(data) != data[2])
    Serial.println("# ERROR: recalibration CRC return value");
  
  calibration = ((uint16_t)data[0] << 8 | data[1]);
  
  Serial.print("# Value after recalibration\n# ");
  Serial.println(calibration-32768);

  // output format
  Serial.println("CO2(ppm)\tTemperature(degC)\tRelativeHumidity(percent)");

  // start scd measurement again in periodic mode, will update every 2 s
  Wire.beginTransmission(SCD_ADDRESS);
  Wire.write(0x21);
  Wire.write(0xb1);
  Wire.endTransmission();

  // wait for first measurement to be finished (> 5 s)
  delay(10000);
}

// calculate CRC according to datasheet section 5.17
uint8_t CalcCrc(uint8_t data[2]) {
  uint8_t crc = 0xFF;
  for(int i = 0; i < 2; i++) {
    crc ^= data[i];
    for(uint8_t bit = 8; bit > 0; --bit) {
      if(crc & 0x80) {
        crc = (crc << 1) ^ 0x31u;
      } else {
        crc = (crc << 1);
      }
    }
  }
  return crc;
}

const unsigned char logo_regosh [] PROGMEM = {
  0x00, 0x00, 0x00, 0x00, 0x00, 0x00, 0x00, 0x00, 0x00, 0x00, 0x60, 0x00, 0x00, 0x00, 0x00, 0x00, 
  0x00, 0x00, 0x00, 0x00, 0x00, 0x00, 0x00, 0x00, 0x00, 0x03, 0xfc, 0x00, 0x00, 0x00, 0x00, 0x00, 
  0x00, 0x00, 0x00, 0x00, 0x00, 0x00, 0x00, 0x00, 0x00, 0x0f, 0xff, 0x00, 0x00, 0x00, 0x00, 0x00, 
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  0x00, 0x00, 0x00, 0x00, 0x00, 0x00, 0x00, 0x00, 0x00, 0x00, 0x00, 0x00, 0x00, 0x0f, 0x00, 0x00
};

const unsigned char humus_logo_plant [] PROGMEM = {
  0x00, 0x00, 0x00, 0x00, 0x00, 0x00, 0x00, 0x00, 0x00, 0x00, 0x00, 0x00, 0x00, 0x00, 0x00, 0x00, 
  0x00, 0x00, 0x00, 0x00, 0x00, 0x00, 0x00, 0x00, 0x00, 0x00, 0x00, 0x00, 0x00, 0x00, 0x00, 0x00, 
  0x00, 0x00, 0x00, 0x00, 0x00, 0x00, 0x00, 0x00, 0x00, 0x00, 0x00, 0x00, 0x00, 0x00, 0x00, 0x00, 
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  0x7f, 0xff, 0xf0, 0x00, 0x00, 0x00, 0x00, 0x00, 0x00, 0x00, 0x00, 0x00, 0x00, 0x00, 0x00, 0x00
};

const unsigned char oursci_logo [] PROGMEM = {
  0x00, 0x00, 0x00, 0x00, 0x00, 0x00, 0x00, 0x00, 0x00, 0x00, 0x00, 0x00, 0x00, 0x00, 0x00, 0x00, 
  0x00, 0x00, 0x00, 0x00, 0x00, 0x00, 0x00, 0x00, 0x00, 0x00, 0x00, 0x00, 0x00, 0x00, 0x00, 0x00, 
  0x00, 0x00, 0x00, 0x00, 0x00, 0x00, 0x00, 0x00, 0x00, 0x00, 0x00, 0x00, 0x00, 0x00, 0x00, 0x00, 
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  0x00, 0x00, 0x00, 0x00, 0x00, 0x00, 0x00, 0x07, 0x00, 0x00, 0x00, 0x00, 0x00, 0x00, 0x00, 0x00
};

const unsigned char hackteria_logo [] PROGMEM = {
  // 'hackteria_logo, 128x64px
  0x00, 0x00, 0x00, 0x00, 0x00, 0x00, 0x00, 0x00, 0x00, 0x00, 0x00, 0x00, 0x00, 0x00, 0x00, 0x00, 
  0x00, 0x00, 0x00, 0x00, 0x00, 0x00, 0x00, 0x00, 0x00, 0x00, 0x00, 0x00, 0x00, 0x00, 0x00, 0x00,
  0x00, 0x00, 0x00, 0x00, 0x00, 0x00, 0x00, 0x00, 0x00, 0x00, 0x00, 0x00, 0x00, 0x00, 0x00, 0x00, 
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  0x00, 0x00, 0x00, 0x00, 0x00, 0x00, 0x00, 0x7f, 0xf8, 0x00, 0x00, 0x00, 0x00, 0x00, 0x00, 0x00
};

// 'humus_logo', 128x64px
const unsigned char humus_logo [] PROGMEM = {
  0x00, 0x00, 0x00, 0x00, 0x00, 0x00, 0x00, 0x00, 0x00, 0x00, 0x00, 0x00, 0x00, 0x00, 0x00, 0x00, 
  0x00, 0x00, 0x00, 0x00, 0x00, 0x00, 0x00, 0x00, 0x00, 0x00, 0x00, 0x00, 0x00, 0x00, 0x00, 0x00, 
  0x00, 0x00, 0x00, 0x00, 0x00, 0x00, 0x00, 0x00, 0x00, 0x00, 0x00, 0x00, 0x00, 0x00, 0x00, 0x00, 
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  0x7f, 0xff, 0xf3, 0xff, 0xff, 0xff, 0xff, 0xff, 0xff, 0xff, 0xff, 0xff, 0xff, 0xff, 0xff, 0xff
};

const unsigned char biomaker_logo [] PROGMEM = {
  0x00, 0x00, 0x00, 0x00, 0x00, 0x00, 0x1f, 0x00, 0x00, 0x00, 0x00, 0x00, 0x00, 0x00, 0x00, 0x00, 
  0x00, 0x00, 0x00, 0x00, 0x00, 0x07, 0xff, 0xf0, 0x00, 0x00, 0x00, 0x00, 0x00, 0x00, 0x00, 0x00, 
  0x00, 0x00, 0x00, 0x00, 0x00, 0x1f, 0xff, 0xf8, 0x00, 0xff, 0xe0, 0x00, 0x00, 0x00, 0x00, 0x00, 
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  0x00, 0x00, 0x00, 0x00, 0x00, 0x00, 0x00, 0x00, 0xe0, 0x00, 0x00, 0x00, 0x00, 0x00, 0x00, 0x00
};

// OLED stuffs **********************
void initDisplay()
{  /* SSD1306_SWITCHCAPVCC = generate display voltage from 3.3V internally
    if(!display.begin(SSD1306_SWITCHCAPVCC, 0x3C)) {
    Serial.println(F("SSD1306 allocation failed"));
    for(;;); // Don't proceed, loop forever
     } 
     */
    display.begin(SSD1306_SWITCHCAPVCC, 0x3C);
    display.clearDisplay();
    /*
    display.setTextSize(2);
    display.setTextColor(WHITE);
    display.setCursor(0, 25);
    display.println("AirQuality");
    display.setTextSize(1);
    display.setCursor(0, 46);
    display.println("BME280 Temp/Hum");
    display.setCursor(0, 56);
    display.println("CCS811 CO2 Sensor");
    display.setTextSize(2);
    display.setCursor(0, 0);
    display.println("ABC");
    */
    display.display();
}

void showLogo_biomaker(){
  display.clearDisplay(); // Make sure the display is cleared
  display.drawBitmap(0, 0, biomaker_logo, 128, 64, WHITE);  
//  display.setTextSize(2);
//  display.setTextColor(WHITE);
//  display.setCursor(24,0);
//  display.println("Biomaker");
  // Update the display
  display.display();
  delay(30);
}

void showLogo_regosh(){
  display.clearDisplay(); // Make sure the display is cleared
  display.drawBitmap(0, 0, logo_regosh, 128, 64, WHITE);  
  // Update the display
  display.display();
  delay(30);
}

void showLogo_oursci(){
  display.clearDisplay(); // Make sure the display is cleared
  display.drawBitmap(0, 0, oursci_logo, 128, 64, WHITE);  
  display.setTextSize(2);
  display.setTextColor(WHITE);
  display.setCursor(24,0);
  display.println("OUR-SCI");
  // Update the display
  display.display();
  delay(30);
}

void showLogo_hackteria(){
  display.clearDisplay(); // Make sure the display is cleared
  display.drawBitmap(0, 0, hackteria_logo, 128, 64, WHITE);  
  display.setTextSize(2);
  display.setTextColor(WHITE);
  display.setCursor(11,0);
  display.println("HACKTERIA");
  // Update the display
  display.display();
  delay(30);
}

void showLogo_humus(){
  display.clearDisplay(); // Make sure the display is cleared
  display.drawBitmap(0, 0, humus_logo, 128, 64, WHITE);  
  // Update the display
  display.display();
  delay(30);
}

void showLogo_humus_text(){
  display.clearDisplay(); // Make sure the display is cleared
  display.drawBitmap(0, 0, humus_logo, 128, 64, WHITE);  
  display.setTextSize(1);
  display.setTextColor(WHITE);
  display.setCursor(38,17);
  display.println("CO2 Respiration");
  display.setTextSize(2);
  display.setTextColor(WHITE);
  display.setCursor(20,0);
  display.println("ROSA CO2");
  // Update the display
  display.display();
  delay(30);
}

void OLEDdrawBackground()
{
    display.clearDisplay();
    for (int i = 28; i <= 128; i = i + 3) {
        display.drawPixel(i, 64 - (400 / displayFactor), WHITE);
    }
    for (int i = 28; i <= 128; i = i + 5) {
        display.drawPixel(i, 64 - ((displayLimit-200) / displayFactor), WHITE);
    }
    
    /*
    for (int i = 28; i <= 128; i = i + 7) {
        display.drawPixel(i, 64 - (3000 / displayFactor), WHITE);
    }
    */
    
    display.drawRect(28, 16, 100, 48, 1); //Border of the bar chart

    display.setTextSize(1);
    display.setTextColor(WHITE);
    display.setCursor(100, 21);
    display.println(displayLimit-200);
    display.setCursor(108, 46);
    display.println("400");
    display.setTextSize(1);
    display.fillRect(29, 46, 70, 17, BLACK);
    display.setCursor(30, 47);
    //display.println("HUMUS.Sapiens");
    display.setCursor(36, 55);
    display.println("CO2 Respiration");
    display.drawBitmap(0, 0, humus_logo_plant, 128, 64, WHITE);
    display.display();
}


void OLEDshowCO2(uint16_t ppm, float temp, float hum)
{   int tempRound = temp;
    int humRound = hum;
    display.setTextSize(1);
    display.fillRect(0, 0, 128, 16, BLACK);
    display.setTextColor(WHITE);
    display.setCursor(38, 0);
    display.println("CO2");
    display.setCursor(38, 7);
    display.println("ppm");
    display.setTextSize(2);
    display.setCursor(56, 0);
    display.print(":");
    display.print(ppm);
    display.setTextSize(1);
    display.setCursor(4, 0);
    display.print(tempRound);
    display.println("T");
    display.setCursor(4, 9);
    display.print(humRound);
    display.println("%");
/*
    if (meas_counter > 0) {
        display.drawLine(meas_counter - 1 + 28, 64 - last_ppm_high_res() / displayFactor, meas_counter + 28, 64 - current->ppm / displayFactor, WHITE);
    }
*/
    if (meas_counter >= 0) {
        display.drawLine(meas_counter - 0 + 28, 64 - 400 / displayFactor, meas_counter + 28, 64 - ppm / displayFactor, WHITE);
    }

    if (meas_counter > 100) {
        meas_counter = 0;
        OLEDdrawBackground();
    }
/*
    if (ppm > thresholdPPM) {
        if (last_ppm_high_res() < thresholdPPM) {
            display.setTextSize(1);
            display.setCursor(h_head + 3, thresholdPPM / displayFactor + 10);
            display.print((millis() - started) / 1000);
            display.println("s");
        }
    }
*/
    display.display();
    delay(300);
}
